## Documentation/devicetree/bindings/mfd/samsung,s2mpg12-pmic.yaml
```yaml
# SPDX-License-Identifier: GPL-2.0-only OR BSD-2-Clause
%YAML 1.2
---
$id: http://devicetree.org/schemas/mfd/samsung,s2mpg12-pmic.yaml#
$schema: http://devicetree.org/meta-schemas/core.yaml#

title: Samsung S2MPG12 Power Management IC

maintainers:
  - Derek Ross <derekross@gmail.com>

description: |
  The Samsung S2MPG12 is the main Power Management IC paired with Google's
  gs201 SoC, with buck converters, LDOs, power meters and a real-time clock.
  It is reached through the ACPM firmware.

  Unlike S2MPG10, it has no interrupt line of its own: it reports events
  in-band, and the SoC's VGPIO2AP system registers turn them into one level
  interrupt with a pending latch that the host acknowledges.

properties:
  compatible:
    const: samsung,s2mpg12-pmic

  interrupts:
    maxItems: 1

  google,vgpio2ap-sysreg:
    $ref: /schemas/types.yaml#/definitions/phandle
    description:
      Phandle to the VGPIO2AP system registers, which latch the PMIC's
      in-band interrupt.

  wakeup-source: true

  regulators:
    type: object
    $ref: /schemas/regulator/samsung,s2mpg12-regulator.yaml
    description:
      LDO regulators. A rail with no child node has no constraints and
      is left as the bootloader set it.

required:
  - compatible
  - interrupts
  - google,vgpio2ap-sysreg

additionalProperties: false

examples:
  - |
    #include <dt-bindings/interrupt-controller/arm-gic.h>
    #include <dt-bindings/interrupt-controller/irq.h>

    pmic {
        compatible = "samsung,s2mpg12-pmic";
        interrupts = <GIC_SPI 72 IRQ_TYPE_LEVEL_HIGH>;
        google,vgpio2ap-sysreg = <&sysreg_vgpio2ap>;
        wakeup-source;
    };
```

## Documentation/devicetree/bindings/regulator/samsung,s2mpg12-regulator.yaml
```yaml
# SPDX-License-Identifier: GPL-2.0-only OR BSD-2-Clause
%YAML 1.2
---
$id: http://devicetree.org/schemas/regulator/samsung,s2mpg12-regulator.yaml#
$schema: http://devicetree.org/meta-schemas/core.yaml#

title: Samsung S2MPG12 Power Management IC regulators

maintainers:
  - Derek Ross <derekross@gmail.com>

description: |
  This is part of the device tree bindings for the S2MPG12 Power Management
  IC (PMIC). Only its 28 LDO regulators are described so far. The buck
  converters are not.

  See also Documentation/devicetree/bindings/mfd/samsung,s2mpg12-pmic.yaml.

patternProperties:
  "^ldo([1-9]|1[0-9]|2[0-8])m$":
    type: object
    $ref: regulator.yaml#
    unevaluatedProperties: false
    description:
      Properties for a single LDO regulator.
    properties:
      regulator-ramp-delay: false

additionalProperties: false
```
